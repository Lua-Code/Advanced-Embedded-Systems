#include "gpioDriver.h"
#include "pins.h"

#include "hw_memmap.h"
#include "sysctl.h"
#include "gpio.h"

void gpioDriverInit(void)
{
		//initialize sys clocks
    SysCtlPeripheralEnable(SYSCTL_PERIPH_GPIOF);
    SysCtlPeripheralEnable(SYSCTL_PERIPH_GPIOE);
    SysCtlPeripheralEnable(SYSCTL_PERIPH_GPIOB);
    SysCtlPeripheralEnable(SYSCTL_PERIPH_GPIOD);

    while (!SysCtlPeripheralReady(SYSCTL_PERIPH_GPIOF));
    while (!SysCtlPeripheralReady(SYSCTL_PERIPH_GPIOE));
    while (!SysCtlPeripheralReady(SYSCTL_PERIPH_GPIOB));
    while (!SysCtlPeripheralReady(SYSCTL_PERIPH_GPIOD));
		
		// LED stuff
    GPIOPinTypeGPIOOutput(GREEN_LED_PORT, GREEN_LED_PIN);
    GPIOPinTypeGPIOOutput(RED_LED_PORT, RED_LED_PIN);
		
		//Button stuff
    GPIOPinTypeGPIOInput(DRIVER_OPEN_PORT, DRIVER_OPEN_PIN);
    GPIOPinTypeGPIOInput(DRIVER_CLOSE_PORT, DRIVER_CLOSE_PIN);
    GPIOPinTypeGPIOInput(SECURITY_OPEN_PORT, SECURITY_OPEN_PIN);
    GPIOPinTypeGPIOInput(SECURITY_CLOSE_PORT, SECURITY_CLOSE_PIN);
    GPIOPinTypeGPIOInput(OPEN_LIMIT_PORT, OPEN_LIMIT_PIN);
    GPIOPinTypeGPIOInput(CLOSED_LIMIT_PORT, CLOSED_LIMIT_PIN);
    GPIOPinTypeGPIOInput(OBSTACLE_PORT, OBSTACLE_PIN);

    GPIOPadConfigSet(DRIVER_OPEN_PORT, DRIVER_OPEN_PIN, GPIO_STRENGTH_2MA, GPIO_PIN_TYPE_STD_WPU);
    GPIOPadConfigSet(DRIVER_CLOSE_PORT, DRIVER_CLOSE_PIN, GPIO_STRENGTH_2MA, GPIO_PIN_TYPE_STD_WPU);

    GPIOPadConfigSet(SECURITY_OPEN_PORT, SECURITY_OPEN_PIN, GPIO_STRENGTH_2MA, GPIO_PIN_TYPE_STD_WPD);
    GPIOPadConfigSet(SECURITY_CLOSE_PORT, SECURITY_CLOSE_PIN, GPIO_STRENGTH_2MA, GPIO_PIN_TYPE_STD_WPD);
    GPIOPadConfigSet(OPEN_LIMIT_PORT, OPEN_LIMIT_PIN, GPIO_STRENGTH_2MA, GPIO_PIN_TYPE_STD_WPD);
    GPIOPadConfigSet(CLOSED_LIMIT_PORT, CLOSED_LIMIT_PIN, GPIO_STRENGTH_2MA, GPIO_PIN_TYPE_STD_WPD);
    GPIOPadConfigSet(OBSTACLE_PORT, OBSTACLE_PIN, GPIO_STRENGTH_2MA, GPIO_PIN_TYPE_STD_WPD);

    GPIOPinWrite(GREEN_LED_PORT, GREEN_LED_PIN, 0);
    GPIOPinWrite(RED_LED_PORT, RED_LED_PIN, 0);
}